## conf/machine/mullet.conf
```bitbake
#@TYPE: Machine
#@NAME: Misfit Vapor
#@DESCRIPTION: Machine configuration for the Misfit Vapor

require conf/machine/include/arm/armv7a/tune-cortexa7.inc
require conf/machine/include/hybris-watch.inc

MACHINE_DISPLAY_ROUND = "true"
MACHINE_HAS_WLAN = "true"

PREFERRED_PROVIDER_virtual/android-system-image = "android"
PREFERRED_VERSION_android = "oreo"

PREFERRED_PROVIDER_virtual/kernel = "linux-mullet"
PREFERRED_VERSION_linux = "3.18+oreo"

IMAGE_INSTALL += "underclock udev-droid-system wifi-enabler"
```
